## conf/layer.conf
```bitbake
# We have a conf and classes directory, append to BBPATH
BBPATH .= ":${LAYERDIR}"

# We have a recipes directory, add to BBFILES
BBFILES += "${LAYERDIR}/recipes*/*/*.bb ${LAYERDIR}/recipes*/*/*.bbappend"

BBFILE_COLLECTIONS += "meta-efikamx"
BBFILE_PATTERN_meta-efikamx := "^${LAYERDIR}/"
BBFILE_PRIORITY_meta-efikamx = "10"
```

## conf/machine/efikamx.conf
```bitbake
#@TYPE: Machine
#@Name: Genesi EFIKA MX Development Platform
#@DESCRIPTION: Machine configuration for the EFIKA MX development platform (http://www.powerdeveloper.org/platforms/efikamx)

PREFERRED_PROVIDER_virtual/libgl  = "mesa-dri"
PREFERRED_PROVIDER_virtual/libx11 ?= "libx11-trim"

PREFERRED_PROVIDER_virtual/xserver = "xserver-xorg"
XSERVER = "xserver-xorg \
           xf86-input-evdev \
           xf86-input-mouse \
           xf86-input-keyboard"


# has DVI connector for external screen
GUI_MACHINE_CLASS = "bigscreen"

PREFERRED_PROVIDER_virtual/kernel ?= "linux-efikamx"

MACHINE_FEATURES = "kernel26 usbhost ext2 alsa"

#don't try to access tty1
USE_VT = "0"

SERIAL_CONSOLE = "115200 ttymxc0"
UBOOT_ENTRYPOINT = "0x90008000"
UBOOT_LOADADDRESS = "0x90008000"

PREFERRED_PROVIDER_virtual/bootloader = "u-boot-efikamx"

#tune for ARMv7/Cortex A8
require conf/machine/include/tune-cortexa8.inc
```
